## dts/bindings/sensor/arribada,argos-smd-spi.yaml
```yaml
description: |
  Argos SMD module SPI interface.

  Provides SPI communication with Argos SMD modules using Protocol A+ framing.
  Supports application commands (0x00-0x2A) and DFU (Device Firmware Update)
  bootloader commands (0x30-0x3F).

  Protocol A+ frame format:
  Request:  | MAGIC (0xAA) | SEQ | CMD | LEN | DATA[0..LEN-1] | CRC8 |
  Response: | MAGIC (0x55) | SEQ | STATUS | LEN | DATA[0..LEN-1] | CRC8 |

compatible: "arribada,argos-smd-spi"

include: spi-device.yaml

properties:
  duplex:
    type: int
    default: 0
    description: |
      Duplex mode: 0 = full duplex (default), 2048 = half duplex.

  frame-format:
    type: int
    default: 0
    description: |
      SPI frame format: 0 = Motorola (default), 1 = TI.

  irq-gpios:
    type: phandle-array
    description: |
      Optional interrupt/ready GPIO pin. When configured, the driver will
      wait for this pin to be asserted before reading a response from the device.
      If not specified, the driver uses a polling approach.

  reset-gpios:
    type: phandle-array
    description: |
      Optional hardware reset GPIO pin. When configured, can be used to
      perform a hardware reset of the Argos SMD module. Toggling reset
      (NRST) also wakes the module from SHUTDOWN, but as a cold boot.

  wakeup-gpios:
    type: phandle-array
    description: |
      Optional wake-up GPIO pin, wired to the STM32 PB3 / WKUP3 line. In
      SHUTDOWN low-power mode the STM32WL55 powers down its VCORE domain and
      the SPI bus is dead; it can only be woken by a rising edge on WKUP3
      (PB3), by NRST, or by its internal RTC. Use argos_spi_wakeup_enable()
      to drive this pin HIGH before communicating with a module that may be in
      SHUTDOWN, and argos_spi_wakeup_disable() to release it. Unlike a reset,
      this wakes the module without a cold boot. If not specified, wake the
      module from SHUTDOWN via reset-gpios (NRST) instead.
```

## tests/spi/testcase.yaml
```yaml
tests:
  spi.argos_smd:
    platform_allow:
      - native_sim
      - native_sim/native/64
    integration_platforms:
      - native_sim
    tags:
      - drivers
      - spi
    build_only: false
```
