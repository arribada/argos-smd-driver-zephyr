## drivers/Kconfig
```kconfig
# menu "argos-smd"
# rsource "argos-smd/Kconfig"
menu "Drivers"
rsource "*/Kconfig"
endmenu
```

## drivers/argos-smd/Kconfig
```kconfig
# Copyright (c) 2025 Arribada Initiative
# SPDX-License-Identifier: Apache-2.0

menuconfig ARGOS_SMD
    bool "Argos SMD satellite modem driver"
    help
      Enable Argos SMD satellite modem driver. This driver supports
      communication with Argos SMD modules via UART (AT commands) or
      SPI (Protocol A+).

if ARGOS_SMD

choice ARGOS_SMD_TRANSPORT
    prompt "Transport interface"
    default ARGOS_SMD_UART

config ARGOS_SMD_UART
    bool "UART (AT commands)"
    depends on UART_INTERRUPT_DRIVEN
    help
      Use UART with AT commands for communication with Argos SMD modules.
      This is the standard interface supporting all AT commands.

config ARGOS_SMD_SPI
    bool "SPI (Protocol A+)"
    depends on SPI
    help
      Use SPI with Protocol A+ binary framing for communication.
      Frame format: [MAGIC(1)] [SEQ(1)] [CMD(1)] [LEN(1)] [DATA(0-250)] [CRC(1)]
      Uses CRC-8 CCITT (polynomial 0x07).

endchoice

# Logging for main driver
module = ARGOS_SMD
module-str = Argos SMD
source "subsys/logging/Kconfig.template.log_config"

# UART-specific configuration
if ARGOS_SMD_UART

# No additional UART-specific configs needed for now

endif # ARGOS_SMD_UART

# SPI-specific configuration
if ARGOS_SMD_SPI

config ARGOS_SMD_SPI_INIT_PRIORITY
    int "Argos SMD SPI driver init priority"
    default 60
    help
      Initialization priority for Argos SMD SPI driver.

endif # ARGOS_SMD_SPI

# DFU support (works with both UART and SPI)
config ARGOS_SMD_DFU
    bool "Enable Device Firmware Update (DFU) support"
    help
      Enable Device Firmware Update (DFU) support for Argos SMD modules.
      This provides an API to perform firmware updates via the selected
      transport interface (UART or SPI).

      DFU Sequence:
      1. Enter bootloader (CMD_DFU_ENTER 0x3F)
      2. Ping bootloader (DFU_PING 0x30)
      3. Get bootloader info (DFU_GET_INFO 0x31)
      4. Erase flash (DFU_ERASE 0x32)
      5. Write chunks (DFU_WRITE_REQ + DFU_WRITE_DATA)
      6. Verify CRC (DFU_VERIFY 0x37)
      7. Jump to app (DFU_JUMP 0x39)

if ARGOS_SMD_DFU
    module = ARGOS_SMD_DFU
    module-str = Argos SMD DFU
    source "subsys/logging/Kconfig.template.log_config"
endif

endif # ARGOS_SMD
```

## dts/bindings/sensor/arribada,argos-smd-uart.yaml
```yaml
description: |
  Argos SMD module UART interface.

  Provides UART communication with Argos SMD modules using AT commands.
  Supports all standard AT commands for configuration, data transmission,
  and device firmware update (DFU).

compatible: "arribada,argos-smd-uart"

include: [base.yaml, uart-device.yaml]

properties:
  wakeup-gpios:
    type: phandle-array
    description: |
      Optional GPIO used to wake up the Argos SMD module from low power mode.
      When the module is configured to use low power mode (AT+LPM), use the
      argos_smd_wakeup_enable() function to set this pin high before
      communicating with the module, and argos_smd_wakeup_disable() to set
      it low when done to allow the module to enter low power mode.
      If not specified, no GPIO control is available and the module should be
      managed by external circuitry or kept always awake.
```

## dts/bindings/sensor/arribada,argossmd.yaml
```yaml
description: |
  Argos SMD module for Up link communication. SMD as a coprocesor over serial.

compatible: "arribada,argossmd"

include: [base.yaml, uart-device.yaml]

properties:
  wakeup-gpios:
    type: phandle-array
    description: |
      Optional GPIO used to wake up the Argos SMD module from low power mode.
      When the module is configured to use low power mode (AT+LPM), use the
      argos_smd_wakeup_enable() function to set this pin high before
      communicating with the module, and argos_smd_wakeup_disable() to set
      it low when done to allow the module to enter low power mode.
      If not specified, no GPIO control is available and the module should be
      managed by external circuitry or kept always awake.
```

## tests/integration/testcase.yaml
```yaml
tests:
  integration.argos_smd:
    harness: ztest
    platform_allow:
      - adafruit_feather_nrf52840
    integration_platforms:
      - adafruit_feather_nrf52840
```

## tests/unit/testcase.yaml
```yaml
tests:
  codec_tests.test_encoding_of_sensor_data:
    platform_allow:
      - adafruit_feather_nrf52840
    tags: driver
```

## west.yml
```yaml
manifest:
  remotes:
    - name: zephyrproject-rtos
      url-base: https://github.com/zephyrproject-rtos
  projects:
    - name: zephyr
      remote: zephyrproject-rtos
      revision: v4.2.0
      import:
        name-allowlist:
          - cmsis_6    # required by the ARM port
          - hal_nordic # required for Nordic
          - segger # required for RTT
  self:
    path: argos-smd-driver-zephyr
```
