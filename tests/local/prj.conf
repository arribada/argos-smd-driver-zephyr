## CMakeLists.txt
```
cmake_minimum_required(VERSION 3.28)

list(APPEND DTS_ROOT ${CMAKE_CURRENT_LIST_DIR}/../..)
find_package(Zephyr REQUIRED HINTS $ENV{ZEPHYR_BASE})

project(host LANGUAGES C)

target_sources(app PRIVATE src/main.c)
```

## prj.conf
```kconfig
CONFIG_ZTEST=y

CONFIG_SERIAL=y
CONFIG_EMUL=y
CONFIG_UART_EMUL=y

CONFIG_ARGOS_SMD=y
CONFIG_UART_INTERRUPT_DRIVEN=y
```

## boards/native_sim.overlay
```dts
/ {
	uart0: uart {
		compatible = "zephyr,uart-emul";
		current-speed = <115200>;
		rx-fifo-size = <256>;
		tx-fifo-size = <256>;
		status = "okay";

		argossmd {
			compatible = "arribada,argos-smd-uart";
		};
	};

};
```

## src/main.c
```c
#include <zephyr/device.h>
#include <zephyr/drivers/serial/uart_emul.h>
#include <zephyr/drivers/uart.h>
#include <zephyr/kernel.h>
#include <zephyr/ztest.h>
#include <zephyr/ztest_assert.h>

#include <argos-smd/argos_smd.h>

#define UART_NODE DT_NODELABEL(uart0)

const static struct device *dev = DEVICE_DT_GET(UART_NODE);
const static struct device *dev_smd = DEVICE_DT_GET_ONE(arribada_argos_smd_uart);

extern void uart_emul_reply(struct k_timer * /*timer_id*/)
{
	char input[] = "+OK\n";
	uart_emul_put_rx_data(dev, (uint8_t *)input, sizeof(input));
}

K_TIMER_DEFINE(uart_emul_reply_timer, uart_emul_reply, NULL);

void *init()
{
	zassert_true(device_is_ready(dev_smd));
	zassert_true(device_is_ready(dev));

	uart_emul_flush_rx_data(dev);
	uart_emul_flush_tx_data(dev);
	uart_emul_set_release_buffer_on_timeout(dev, true);

	return NULL;
}

ZTEST(comms, test_basic)
{
	char out[ARGOS_SMD_BUF_SIZE];

	k_timer_start(&uart_emul_reply_timer, K_MSEC(10), K_NO_WAIT);
	char msg[9] = "FFFFFFFF";
	zassert_ok(argos_send_payload(dev_smd, msg));

	char expected[] = "AT+TX=FFFFFFFF";
	uart_emul_get_tx_data(dev, (uint8_t *)out, sizeof(out));
	zassert_true(memcmp(expected, out, sizeof(expected)));

	k_timer_start(&uart_emul_reply_timer, K_MSEC(10), K_NO_WAIT);
	char msg2[] = "FFFF";
	zassert_ok(argos_set_address(dev_smd, msg2));
	uart_emul_get_tx_data(dev, (uint8_t *)out, sizeof(out));
	char expected2[] = "AT+ADDR=FFF";
	zassert_true(memcmp(expected2, out, sizeof(expected2)));
}

ZTEST_SUITE(comms, NULL, init, NULL, NULL, NULL);
```
